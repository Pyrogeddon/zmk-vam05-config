## config/west.yml
```yaml
manifest:
  remotes:
    - name: zmkfirmware
      url-base: https://github.com/zmkfirmware
    - name: zzeneg # <-- required for Raw HID module
      url-base: https://github.com/zzeneg
    - name: srwi # <-- required for KeyPeek module
      url-base: https://github.com/srwi
    - name: caksoylar  # <-- rgb remote add
      url-base: https://github.com/caksoylar  # <-- rgb remote add
    - name: Gasiro
      url-base: https://github.com/Gasiro
  projects:
    - name: zmk
      remote: zmkfirmware
      revision: v0.3
      import: app/west.yml
    - name: zmk-raw-hid # <-- Raw HID module
      remote: zzeneg
      revision: main
    - name: zmk-keypeek-layer-notifier # <-- KeyPeek module
      remote: srwi
      revision: master
    - name: zmk-rgbled-widget  # <-- rgb remote add
      remote: caksoylar  # <-- rgb remote add
      revision: v0.3  # <-- rgb remote add
    - name: zmk-batt-led-indicator
      remote: Gasiro
      revision: main
  self:
    path: config
```
